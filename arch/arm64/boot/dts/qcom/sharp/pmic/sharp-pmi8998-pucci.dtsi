/* Copyright (c) 2014-2016, The Linux Foundation. All rights reserved.
 *
 * This program is free software; you can redistribute it and/or modify
 * it under the terms of the GNU General Public License version 2 and
 * only version 2 as published by the Free Software Foundation.
 *
 * This program is distributed in the hope that it will be useful,
 * but WITHOUT ANY WARRANTY; without even the implied warranty of
 * MERCHANTABILITY or FITNESS FOR A PARTICULAR PURPOSE.  See the
 * GNU General Public License for more details.
 */

#include "sharp-chg-param-pmi8998-pucci.dtsi"

/*****************************************/
/*  pmi8998: qcom,pmi8998 alias          */
/*****************************************/

/*****************************************/
/*  pmi8998-gpios: qpnp-pin              */
/*****************************************/

/*****************************************/
/*  pmi8998_charger                    */
/*****************************************/

&vendor {
	sharp_845_3rd_batterydata: qcom,battery-data {
		#include "fg-gen3-batterydata-sharp-845-3rd.dtsi"
	};
};

&pmi8998_charger {
	qcom,battery-data = <&sharp_845_3rd_batterydata>;
};

/*****************************************/
/*  pmi8998_fg                         */
/*****************************************/
&pmi8998_fg {
	qcom,battery-data = <&sharp_845_3rd_batterydata>;
};

/*
 * Copyright (c) 2016-2017, The Linux Foundation. All rights reserved.
 *
 * This program is free software; you can redistribute it and/or modify
 * it under the terms of the GNU General Public License version 2 and
 * only version 2 as published by the Free Software Foundation.
 *
 * This program is distributed in the hope that it will be useful,
 * but WITHOUT ANY WARRANTY; without even the implied warranty of
 * MERCHANTABILITY or FITNESS FOR A PARTICULAR PURPOSE.  See the
 * GNU General Public License for more details.
 */


&pmi8998_pdphy {
	vbus-supply = <&smb2_vbus>;
};

// disable usb2_ext_5v_boost_default

&ext_5v_boost
 {
    /delete-property/ gpio;
    /delete-property/ pinctrl-0;
};

&usb1 {
	status = "disabled";
};

/* SH_USB_DRIVER -> */
&qusb_phy0 {
	pinctrl-names = "atest_usb13_suspend", "atest_usb13_active";
	pinctrl-0 = <&atest_usb13_suspend>;
	pinctrl-1 = <&atest_usb13_active>;
	reg = <0x088e2000 0x400>,
		<0x088e0000 0x2000>;
	reg-names = "qusb_phy_base", "eud_base";
		qcom,qusb-phy-init-seq =
			/* <value reg_offset> */
			   <0x23 0x210 /* PWR_CTRL1 */
			    0x03 0x04  /* PLL_ANALOG_CONTROLS_TWO */
			    0x7c 0x18c /* PLL_CLOCK_INVERTERS */
			    0x80 0x2c  /* PLL_CMODE */
			    0x0a 0x184 /* PLL_LOCK_DELAY */
			    0x19 0xb4  /* PLL_DIGITAL_TIMERS_TWO */
			    0x40 0x194 /* PLL_BIAS_CONTROL_1 */
			    0x20 0x198 /* PLL_BIAS_CONTROL_2 */
			    0x21 0x214 /* PWR_CTRL2 */
			    0x07 0x220 /* IMP_CTRL1 */
			    0x58 0x224 /* IMP_CTRL2 */
			    0x77 0x240 /* TUNE1 */
			    0x29 0x244 /* TUNE2 */
			    0xca 0x248 /* TUNE3 */
			    0x04 0x24c /* TUNE4 */
			    0x03 0x250 /* TUNE5 */
			    0x00 0x23c /* CHG_CTRL2 */
			    0x22 0x210>; /* PWR_CTRL1 */
};
/* SH_USB_DRIVER <- */

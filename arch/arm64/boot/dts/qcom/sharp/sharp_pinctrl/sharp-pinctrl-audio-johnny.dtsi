/* Copyright (c) 2016, The Linux Foundation. All rights reserved.
 *
 * This program is free software; you can redistribute it and/or modify
 * it under the terms of the GNU General Public License version 2 and
 * only version 2 as published by the Free Software Foundation.
 *
 * This program is distributed in the hope that it will be useful,
 * but WITHOUT ANY WARRANTY; without even the implied warranty of
 * MERCHANTABILITY or FITNESS FOR A PARTICULAR PURPOSE.  See the
 * GNU General Public License for more details.
 */
&tlmm{
/* SH_AUDIO_DRIVER -> */ /*A-001*/
	cdc_reset_ctrl {
		cdc_reset_active:cdc_reset_active {
			config {
				pins = "gpio64";
				drive-strength = <2>;
				bias-disable;
				output-high;
			};
		};
	};
/* SH_AUDIO_DRIVER <- */ /*A-001*/
};

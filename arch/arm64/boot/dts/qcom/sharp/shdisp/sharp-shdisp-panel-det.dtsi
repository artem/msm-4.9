/* Copyright (c) 2017, The Linux Foundation. All rights reserved.
 *
 * This program is free software; you can redistribute it and/or modify
 * it under the terms of the GNU General Public License version 2 and
 * only version 2 as published by the Free Software Foundation.
 *
 * This program is distributed in the hope that it will be useful,
 * but WITHOUT ANY WARRANTY; without even the implied warranty of
 * MERCHANTABILITY or FITNESS FOR A PARTICULAR PURPOSE.  See the
 * GNU General Public License for more details.
 */

&soc {
	sharp_mdss_panel_det: sharp,mdss_panel_det {
		compatible = "sharp,panel_det";
		detin =<&pmi8998_gpios 11 0>;
		interrupts = <0x2 0xca 0x0>;
		interrupt-parent = <&spmi_bus>;
		interrupt-names = "detin";
		status="ok";
	};

	sharp_mdss_panel_mipierr: sharp,mdss_panel_mipierr {
		compatible = "sharp,panel_mipierr";
		mipierr = <&tlmm 11 0>;
		interrupts = <11 0>;
		interrupt-parent = <&tlmm>;
		interrupt-names = "mipierr";
		status="ok";
	};
};
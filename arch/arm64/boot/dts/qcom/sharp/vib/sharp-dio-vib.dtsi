/* Copyright (c) 2016, The Linux Foundation. All rights reserved.
 *
 * This program is free software; you can redistribute it and/or modify
 * it under the terms of the GNU General Public License version 2 and
 * only version 2 as published by the Free Software Foundation.
 *
 * This program is distributed in the hope that it will be useful,
 * but WITHOUT ANY WARRANTY; without even the implied warranty of
 * MERCHANTABILITY or FITNESS FOR A PARTICULAR PURPOSE.  See the
 * GNU General Public License for more details.
 */

&pmi8998_haptics {
	qcom,wave-play-rate-us = <4255>;
	qcom,actuator-type = <0>;
	qcom,wave-shape = "sine";
	qcom,vmax-mv = <1740>; 
	qcom,brake-pattern = <3 2 1 0>;
	qcom,lra-high-z = "opt1";
	qcom,lra-auto-res-mode = "qwd";
	qcom,lra-res-cal-period = <4>;
};

/* Copyright (c) 2017, The Linux Foundation. All rights reserved.
 *
 * This program is free software; you can redistribute it and/or modify
 * it under the terms of the GNU General Public License version 2 and
 * only version 2 as published by the Free Software Foundation.
 *
 * This program is distributed in the hope that it will be useful,
 * but WITHOUT ANY WARRANTY; without even the implied warranty of
 * MERCHANTABILITY or FITNESS FOR A PARTICULAR PURPOSE.  See the
 * GNU General Public License for more details.
 */

&mdss_mdp {

	/*---------------------*/
	/* LCD Panel (MDP/DSI) */
	/*---------------------*/
	dsi_shdisp_rosetta_dual_qd_video: sharp,shdisp_rosetta_dual_qd_video {
		qcom,mdss-dsi-panel-name = "sharp 1440p video mode dsi panel dual";
		qcom,mdss-dsi-panel-type = "dsi_video_mode";
		qcom,mdss-dsi-virtual-channel-id = <0>;
		qcom,mdss-dsi-stream = <0>;

		qcom,mdss-pan-physical-width-dimension = <65>;
		qcom,mdss-pan-physical-height-dimension = <137>;

		qcom,mdss-dsi-bpp = <24>;
		qcom,mdss-dsi-color-order = "rgb_swap_rgb";
		qcom,mdss-dsi-underflow-color = <0xff>;
		qcom,mdss-dsi-border-color = <0>;

		//qcom,mdss-dsi-post-panel-on-command-state = "dsi_lp_mode";

		qcom,mdss-dsi-traffic-mode = "non_burst_sync_event";
		qcom,mdss-dsi-bllp-eof-power-mode;
		qcom,mdss-dsi-bllp-power-mode;
		qcom,mdss-dsi-lane-0-state;
		qcom,mdss-dsi-lane-1-state;
		qcom,mdss-dsi-lane-2-state;
		qcom,mdss-dsi-lane-3-state;

		qcom,mdss-dsi-t-clk-post = <0x0C>;
		qcom,mdss-dsi-t-clk-pre = <0x2A>;

		qcom,mdss-dsi-dma-trigger = "trigger_sw";
		qcom,mdss-dsi-mdp-trigger = "none";

		qcom,mdss-dsi-bl-min-level = <1>;
		qcom,mdss-dsi-bl-max-level = <4095>;
		qcom,mdss-dsi-bl-pmic-control-type = "bl_ctrl_wled";
		qcom,panel-supply-entries = <&dsi_panel_pwr_supply>;
		qcom,platform-reset-gpio = <&tlmm 6 0>;

		qcom,mdss-dsi-panel-hdr-enabled;
		qcom,mdss-dsi-panel-hdr-color-primaries = <15635 16450 34000
							   16000 13250 34500 7500 3000>;
		qcom,mdss-dsi-panel-peak-brightness = <4000000>;
		qcom,mdss-dsi-panel-blackness-level = <5000>;
		qcom,mdss-dsi-panel-average-brightness = <4000000>;

		qcom,dcs-cmd-by-left;
		qcom,mdss-dsi-tx-eot-append;
		qcom,mdss-dsi-lp11-init;
		qcom,mdss-dsi-reset-sequence = <1 20>, <0 1>, <1 10>;

		sharp,ext_clk-post-on-sleep-ms = <1>;
		sharp,ext_clk-post-off-sleep-ms = <1>;

		qcom,mdss-dsi-display-timings {
				timing@0{
						qcom,mdss-dsi-panel-clockrate = <0 767680000>;

						qcom,mdss-dsi-panel-width = <720>;
						qcom,mdss-dsi-panel-height = <3040>;

						qcom,mdss-dsi-h-front-porch = <152>;
						qcom,mdss-dsi-h-back-porch = <20>;
						qcom,mdss-dsi-h-pulse-width = <4>;
						qcom,mdss-dsi-h-sync-skew = <0>;
						qcom,mdss-dsi-v-back-porch = <12>;
						qcom,mdss-dsi-v-front-porch = <21>;
						qcom,mdss-dsi-v-pulse-width = <2>;

						qcom,mdss-dsi-h-left-border = <0>;
						qcom,mdss-dsi-h-right-border = <0>;
						qcom,mdss-dsi-v-top-border = <0>;
						qcom,mdss-dsi-v-bottom-border = <0>;

						qcom,mdss-dsi-panel-framerate = <100>;

						qcom,mdss-dsi-panel-phy-timings = [00 1A 07 06 22 21 07 07 04 03 04 00];

						qcom,display-topology = <2 2 2>;
						qcom,default-topology-index = <0>;

						qcom,mdss-dsi-on-command = [
							39 01 00 00 00 00 02 FF 20
							39 01 00 00 01 00 02 2A 20
							39 01 00 00 00 00 02 FF 10
							39 01 00 00 00 00 02 FB 01
							39 01 00 00 00 00 02 BA 03
							39 01 00 00 00 00 02 BC 18
							39 01 00 00 00 00 02 C0 83
							39 01 00 00 00 00 11 C1 89 28 00 08 02 00 02 68 00 D5 00 0A 0D B7 09 89
							39 01 00 00 00 00 03 C2 10 F0
							39 01 00 00 00 00 02 D5 00
							39 01 00 00 00 00 02 D6 00
							39 01 00 00 00 00 02 DE 00
							39 01 00 00 00 00 02 E1 00
							39 01 00 00 00 00 02 E5 01
							39 01 00 00 00 00 02 BB 03
							39 01 00 00 00 00 02 F6 71
							39 01 00 00 00 00 02 F7 80
							39 01 00 00 00 00 05 BE 00 0E 00 15
							39 01 00 00 00 00 05 2A 00 00 05 9F
							39 01 00 00 00 00 05 2B 00 00 09 FF
							39 01 00 00 00 00 02 35 00
							39 01 00 00 00 00 02 FF 20
							39 01 00 00 00 00 02 FB 01
							39 01 00 00 00 00 02 00 01
							39 01 00 00 00 00 02 01 55
							39 01 00 00 00 00 02 02 55
							39 01 00 00 00 00 02 03 55
							39 01 00 00 00 00 02 05 00
							39 01 00 00 00 00 02 06 A1
							39 01 00 00 00 00 02 07 E8
							39 01 00 00 00 00 02 08 DF
							39 01 00 00 00 00 02 0C E0
							39 01 00 00 00 00 02 0D D7
							39 01 00 00 00 00 02 21 54
							39 01 00 00 00 00 02 22 11
							39 01 00 00 00 00 02 2F 00
							39 01 00 00 00 00 02 37 00
							39 01 00 00 00 00 02 38 00
							39 01 00 00 00 00 02 39 00
							39 01 00 00 00 00 02 5D 04
							39 01 00 00 00 00 02 5E 14
							39 01 00 00 00 00 02 5F ED
							39 01 00 00 00 00 02 96 00
							39 01 00 00 00 00 02 97 BD
							39 01 00 00 00 00 02 98 BD
							39 01 00 00 00 00 02 AA C1
							39 01 00 00 00 00 02 AD 00
							39 01 00 00 00 00 02 AE 00
							39 01 00 00 00 00 02 FF 23
							39 01 00 00 00 00 02 FB 01
							39 01 00 00 00 00 02 00 80
							39 01 00 00 00 00 02 07 20
							39 01 00 00 00 00 02 08 01
							39 01 00 00 00 00 02 09 00
							39 01 00 00 00 00 02 B7 00
							39 01 00 00 00 00 02 B8 00
							39 01 00 00 00 00 02 B9 00
							39 01 00 00 00 00 02 BA 00
							39 01 00 00 00 00 02 BB 00
							39 01 00 00 00 00 02 BC 00
							39 01 00 00 00 00 02 BD 00
							39 01 00 00 00 00 02 BE 00
							39 01 00 00 00 00 02 BF 00
							39 01 00 00 00 00 02 C0 00
							39 01 00 00 00 00 02 FF 24
							39 01 00 00 00 00 02 FB 01
							39 01 00 00 00 00 02 00 20
							39 01 00 00 00 00 02 01 7C
							39 01 00 00 00 00 02 6E 01
							39 01 00 00 00 00 02 02 00
							39 01 00 00 00 00 02 07 00
							39 01 00 00 00 00 02 08 00
							39 01 00 00 00 00 02 09 69
							39 01 00 00 00 00 02 11 00
							39 01 00 00 00 00 02 12 00
							39 01 00 00 00 00 02 13 69
							39 01 00 00 00 00 02 14 00
							39 01 00 00 00 00 02 15 0E
							39 01 00 00 00 00 02 16 00
							39 01 00 00 00 00 02 17 15
							39 01 00 00 00 00 02 1F 00
							39 01 00 00 00 00 02 20 00
							39 01 00 00 00 00 02 21 6D
							39 01 00 00 00 00 02 22 00
							39 01 00 00 00 00 02 23 10
							39 01 00 00 00 00 02 24 00
							39 01 00 00 00 00 02 25 10
							39 01 00 00 00 00 02 2B 50
							39 01 00 00 00 00 02 2D 0F
							39 01 00 00 00 00 02 30 1A
							39 01 00 00 00 00 02 32 00
							39 01 00 00 00 00 02 35 00
							39 01 00 00 00 00 02 37 22
							39 01 00 00 00 00 02 38 BB
							39 01 00 00 00 00 02 3B 33
							39 01 00 00 00 00 02 43 00
							39 01 00 00 00 00 02 54 AA
							39 01 00 00 00 00 02 55 0A
							39 01 00 00 00 00 02 5A 03
							39 01 00 00 00 00 02 5D 40
							39 01 00 00 00 00 02 5F 66
							39 01 00 00 00 00 02 60 66
							39 01 00 00 00 00 02 70 0E
							39 01 00 00 00 00 02 7D 01
							39 01 00 00 00 00 02 7E 5C
							39 01 00 00 00 00 02 80 01
							39 01 00 00 00 00 02 81 5C
							39 01 00 00 00 00 02 82 53
							39 01 00 00 00 00 02 8E 04
							39 01 00 00 00 00 02 96 00
							39 01 00 00 00 00 02 97 01
							39 01 00 00 00 00 02 B3 10
							39 01 00 00 00 00 02 B4 06
							39 01 00 00 00 00 02 B5 25
							39 01 00 00 00 00 02 B6 11
							39 01 00 00 00 00 02 B7 00
							39 01 00 00 00 00 02 B8 00
							39 01 00 00 00 00 02 B9 00
							39 01 00 00 00 00 02 BA C0
							39 01 00 00 00 00 02 BB 04
							39 01 00 00 00 00 02 BC 64
							39 01 00 00 00 00 02 BD 19
							39 01 00 00 00 00 02 BE 64
							39 01 00 00 00 00 02 BF 19
							39 01 00 00 00 00 02 C0 05
							39 01 00 00 00 00 02 C1 10
							39 01 00 00 00 00 02 C2 FB
							39 01 00 00 00 00 02 C3 FF
							39 01 00 00 00 00 02 FF 25
							39 01 00 00 00 00 02 FB 01
							39 01 00 00 00 00 02 00 27
							39 01 00 00 00 00 02 01 27
							39 01 00 00 00 00 02 02 27
							39 01 00 00 00 00 02 03 27
							39 01 00 00 00 00 02 04 04
							39 01 00 00 00 00 02 05 02
							39 01 00 00 00 00 02 06 0E
							39 01 00 00 00 00 02 07 0A
							39 01 00 00 00 00 02 08 10
							39 01 00 00 00 00 02 09 0C
							39 01 00 00 00 00 02 0A 27
							39 01 00 00 00 00 02 0B 06
							39 01 00 00 00 00 02 0C 26
							39 01 00 00 00 00 02 0D 26
							39 01 00 00 00 00 02 0E 26
							39 01 00 00 00 00 02 0F 26
							39 01 00 00 00 00 02 10 26
							39 01 00 00 00 00 02 11 26
							39 01 00 00 00 00 02 12 26
							39 01 00 00 00 00 02 13 26
							39 01 00 00 00 00 02 14 27
							39 01 00 00 00 00 02 15 27
							39 01 00 00 00 00 02 16 27
							39 01 00 00 00 00 02 17 27
							39 01 00 00 00 00 02 18 05
							39 01 00 00 00 00 02 19 03
							39 01 00 00 00 00 02 1A 0F
							39 01 00 00 00 00 02 1B 0B
							39 01 00 00 00 00 02 1C 11
							39 01 00 00 00 00 02 1D 0D
							39 01 00 00 00 00 02 1E 27
							39 01 00 00 00 00 02 1F 06
							39 01 00 00 00 00 02 20 26
							39 01 00 00 00 00 02 21 26
							39 01 00 00 00 00 02 22 26
							39 01 00 00 00 00 02 23 26
							39 01 00 00 00 00 02 24 26
							39 01 00 00 00 00 02 25 26
							39 01 00 00 00 00 02 26 26
							39 01 00 00 00 00 02 27 26
							39 01 00 00 00 00 02 58 06
							39 01 00 00 00 00 02 59 04
							39 01 00 00 00 00 02 5A 33
							39 01 00 00 00 00 02 5B 02
							39 01 00 00 00 00 02 5C 02
							39 01 00 00 00 00 02 5D 01
							39 01 00 00 00 00 02 5E 00
							39 01 00 00 00 00 02 5F 00
							39 01 00 00 00 00 02 60 0B
							39 01 00 00 00 00 02 61 0B
							39 01 00 00 00 00 02 62 00
							39 01 00 00 00 00 02 63 00
							39 01 00 00 00 00 02 64 20
							39 01 00 00 00 00 02 65 02
							39 01 00 00 00 00 02 66 02
							39 01 00 00 00 00 02 67 00
							39 01 00 00 00 00 02 68 44
							39 01 00 00 00 00 02 69 11
							39 01 00 00 00 00 02 6A 02
							39 01 00 00 00 00 02 6B 02
							39 01 00 00 00 00 02 6C 06
							39 01 00 00 00 00 02 6D 31
							39 01 00 00 00 00 02 6E 11
							39 01 00 00 00 00 02 7F 01
							39 01 00 00 00 00 02 80 00
							39 01 00 00 00 00 02 81 00
							39 01 00 00 00 00 02 82 00
							39 01 00 00 00 00 02 83 00
							39 01 00 00 00 00 02 84 00
							39 01 00 00 00 00 02 89 0A
							39 01 00 00 00 00 02 8D 00
							39 01 00 00 00 00 02 92 01
							39 01 00 00 00 00 02 93 23
							39 01 00 00 00 00 02 94 20
							39 01 00 00 00 00 02 95 20
							39 01 00 00 00 00 02 96 01
							39 01 00 00 00 00 02 97 32
							39 01 00 00 00 00 02 9E 00
							39 01 00 00 00 00 02 9F 00
							39 01 00 00 00 00 02 A0 00
							39 01 00 00 00 00 02 A2 00
							39 01 00 00 00 00 02 A3 00
							39 01 00 00 00 00 02 A4 00
							39 01 00 00 00 00 02 BB C4
							39 01 00 00 00 00 02 BC 04
							39 01 00 00 00 00 02 BD 41
							39 01 00 00 00 00 02 BE D0
							39 01 00 00 00 00 02 BF D8
							39 01 00 00 00 00 02 C2 79
							39 01 00 00 00 00 02 C4 00
							39 01 00 00 00 00 02 C5 10
							39 01 00 00 00 00 02 C6 23
							39 01 00 00 00 00 02 C7 40
							39 01 00 00 00 00 02 C8 00
							39 01 00 00 00 00 02 C9 00
							39 01 00 00 00 00 02 CA 00
							39 01 00 00 00 00 02 CB 00
							39 01 00 00 00 00 02 CC 00
							39 01 00 00 00 00 02 CD 00
							39 01 00 00 00 00 02 CE 00
							39 01 00 00 00 00 02 CF 00
							39 01 00 00 00 00 02 D7 16
							39 01 00 00 00 00 02 D8 AA
							39 01 00 00 00 00 02 D9 2A
							39 01 00 00 00 00 02 DA 00
							39 01 00 00 00 00 02 DB AA
							39 01 00 00 00 00 02 DF 8A
							39 01 00 00 00 00 02 E2 80
							39 01 00 00 00 00 02 E3 33
							39 01 00 00 00 00 02 E4 C0
							39 01 00 00 00 00 02 E5 33
							39 01 00 00 00 00 02 E6 C0
							39 01 00 00 00 00 02 E7 00
							39 01 00 00 00 00 02 E8 00
							39 01 00 00 00 00 02 E9 40
							39 01 00 00 00 00 02 EA 40
							39 01 00 00 00 00 02 EB C0
							39 01 00 00 00 00 02 EC A8
							39 01 00 00 00 00 02 ED A8
							39 01 00 00 00 00 02 EE 00
							39 01 00 00 00 00 02 EF A8
							39 01 00 00 00 00 02 FF 26
							39 01 00 00 00 00 02 FB 01
							39 01 00 00 00 00 02 00 08
							39 01 00 00 00 00 02 01 05
							39 01 00 00 00 00 02 02 00
							39 01 00 00 00 00 02 03 00
							39 01 00 00 00 00 02 04 14
							39 01 00 00 00 00 02 05 00
							39 01 00 00 00 00 02 06 04
							39 01 00 00 00 00 02 07 0C
							39 01 00 00 00 00 02 08 00
							39 01 00 00 00 00 02 09 41
							39 01 00 00 00 00 02 B9 11
							39 01 00 00 00 00 02 0A 40
							39 01 00 00 00 00 02 0B 40
							39 01 00 00 00 00 02 0C 40
							39 01 00 00 00 00 02 0D 05
							39 01 00 00 00 00 02 0E 02
							39 01 00 00 00 00 02 0F 23
							39 01 00 00 00 00 02 10 00
							39 01 00 00 00 00 02 11 55
							39 01 00 00 00 00 02 13 35
							39 01 00 00 00 00 02 14 35
							39 01 00 00 00 00 02 15 35
							39 01 00 00 00 00 02 16 35
							39 01 00 00 00 00 02 18 80
							39 01 00 00 00 00 02 19 06
							39 01 00 00 00 00 02 5D 20
							39 01 00 00 00 00 02 E4 80
							39 01 00 00 00 00 02 20 00
							39 01 00 00 00 00 02 21 15
							39 01 00 00 00 00 02 22 00
							39 01 00 00 00 00 02 23 00
							39 01 00 00 00 00 02 24 00
							39 01 00 00 00 00 02 26 00
							39 01 00 00 00 00 02 29 00
							39 01 00 00 00 00 02 2A 00
							39 01 00 00 00 00 02 36 00
							39 01 00 00 00 00 02 37 05
							39 01 00 00 00 00 02 38 00
							39 01 00 00 00 00 02 5B 01
							39 01 00 00 00 00 02 63 FB
							39 01 00 00 00 00 02 64 C3
							39 01 00 00 00 00 02 68 08
							39 01 00 00 00 00 02 69 00
							39 01 00 00 00 00 02 6A 22
							39 01 00 00 00 00 02 6C F0
							39 01 00 00 00 00 02 7F 00
							39 01 00 00 00 00 02 84 3F
							39 01 00 00 00 00 02 85 3F
							39 01 00 00 00 00 02 87 33
							39 01 00 00 00 00 02 88 33
							39 01 00 00 00 00 02 8A 33
							39 01 00 00 00 00 02 E1 0A
							39 01 00 00 00 00 02 E2 00
							39 01 00 00 00 00 02 E5 00
							39 01 00 00 00 00 02 25 78
							39 01 00 00 00 00 02 27 78
							39 01 00 00 00 00 02 28 20
							39 01 00 00 00 00 02 36 08
							39 01 00 00 00 00 02 60 00
							39 01 00 00 00 00 02 61 00
							39 01 00 00 00 00 02 62 FF
							39 01 00 00 00 00 02 65 9F
							39 01 00 00 00 00 02 66 10
							39 01 00 00 00 00 02 41 00
							39 01 00 00 00 00 02 42 00
							39 01 00 00 00 00 02 43 00
							39 01 00 00 00 00 02 44 00
							39 01 00 00 00 00 02 45 00
							39 01 00 00 00 00 02 46 00
							39 01 00 00 00 00 02 47 00
							39 01 00 00 00 00 02 48 00
							39 01 00 00 00 00 02 49 00
							39 01 00 00 00 00 02 4A 00
							39 01 00 00 00 00 02 4B 00
							39 01 00 00 00 00 02 4C 00
							39 01 00 00 00 00 02 4D 00
							39 01 00 00 00 00 02 4E 00
							39 01 00 00 00 00 02 4F 00
							39 01 00 00 00 00 02 50 00
							39 01 00 00 00 00 02 51 00
							39 01 00 00 00 00 02 40 00
							39 01 00 00 00 00 02 31 00
							39 01 00 00 00 00 02 32 00
							39 01 00 00 00 00 02 33 00
							39 01 00 00 00 00 02 34 00
							39 01 00 00 00 00 02 35 00
							39 01 00 00 00 00 02 30 00
							39 01 00 00 00 00 02 FF 27
							39 01 00 00 00 00 02 FB 01
							39 01 00 00 00 00 05 B1 30 03 21 EF
							39 01 00 00 00 00 05 B2 01 23 00 56
							39 01 00 00 00 00 09 B3 55 AA 9B 30 00 FF 30 60
							39 01 00 00 00 00 0D B4 00 00 40 00 00 40 20 20 00 09 2E 09
							39 01 00 00 00 00 0D B5 00 30 10 00 33 0D 00 40 00 00 37 09
							39 01 00 00 00 00 0D B6 20 20 00 0D 33 00 20 20 00 09 37 00
							39 01 00 00 00 00 0D B7 00 00 40 00 00 40 20 20 00 09 2E 09
							39 01 00 00 00 00 0D B8 00 30 10 00 33 0D 00 40 00 00 37 09
							39 01 00 00 00 00 0D B9 20 20 00 0D 33 00 20 20 00 09 37 00
							39 01 00 00 00 00 11 BA 01 C0 01 80 01 40 01 00 00 C0 00 80 00 40 00 00
							39 01 00 00 00 00 11 BB 03 C0 03 80 03 40 03 00 02 C0 02 80 02 40 02 00
							39 01 00 00 00 00 05 BC 00 00 04 00
							39 01 00 00 00 00 11 BD 01 C0 01 80 01 40 01 00 00 C0 00 80 00 40 00 00
							39 01 00 00 00 00 11 BE 03 C0 03 80 03 40 03 00 02 C0 02 80 02 40 02 00
							39 01 00 00 00 00 05 BF 00 00 04 00
							39 01 00 00 00 00 11 C0 01 C0 01 80 01 40 01 00 00 C0 00 80 00 40 00 00
							39 01 00 00 00 00 11 C1 03 C0 03 80 03 40 03 00 02 C0 02 80 02 40 02 00
							39 01 00 00 00 00 05 C2 00 00 04 00
							39 01 00 00 00 00 05 CF 08 40 3D A8
							39 01 00 00 00 00 06 D0 00 00 00 00 00
							39 01 00 00 00 00 07 D1 80 1C 0F B1 F3 42
							39 01 00 00 00 00 02 D2 74
							39 01 00 00 00 00 04 DA AB 40 0C
							39 01 00 00 00 00 0A DB 00 0E EE EE ED DD DE EE 00
							39 01 00 00 00 00 06 DC 0F EC B9 86 54
							39 01 00 00 00 00 02 D9 00
							39 01 00 00 00 00 02 DD 00
							39 01 00 00 00 00 02 DF 00
							39 01 00 00 00 00 02 FA 01
							39 01 00 00 00 00 02 FF 28
							39 01 00 00 00 00 02 FB 01
							39 01 00 00 00 00 02 02 03
							39 01 00 00 00 00 02 0C 00
							39 01 00 00 00 00 02 12 40
							39 01 00 00 0A 00 02 91 02
							39 01 00 00 00 00 02 FF E0
							39 01 00 00 00 00 02 FB 01
							39 01 00 00 00 00 02 84 89
							39 01 00 00 00 00 02 82 11
							39 01 00 00 00 00 02 7A 22
							39 01 00 00 00 00 02 81 65
							39 01 00 00 00 00 02 FF F0
							39 01 00 00 00 00 02 FB 01
							39 01 00 00 00 00 02 33 BC
							39 01 00 00 00 00 02 34 34
							39 01 00 00 00 00 02 FF 21
							39 01 00 00 00 00 02 FB 01
							39 01 00 00 00 00 02 FF 10
							39 01 00 00 00 00 02 BC 1A
							05 01 00 00 3C 00 02 11 00
						];

						sharp,mdss-dsi-typ-volt-command = [
							39 01 00 00 00 00 02 FF 20
							39 01 00 00 00 00 02 07 E8
							39 01 00 00 00 00 02 08 DF
							39 01 00 00 00 00 02 0C E0
							39 01 00 00 00 00 02 0D D7
							39 01 00 00 00 00 02 96 00
							39 01 00 00 00 00 02 97 BD
							39 01 00 00 00 00 02 98 BD
						];

						sharp,mdss-dsi-typ-gmm-command = [
							39 01 00 00 00 00 11 B0 00 73 00 82 00 9E 00 B4 00 C8 00 D9 00 EA 00 F9
							39 01 00 00 00 00 11 B1 01 05 01 35 01 5A 01 99 01 C8 02 13 02 50 02 51
							39 01 00 00 00 00 11 B2 02 89 02 C6 02 EC 03 1A 03 3E 03 63 03 70 03 7D
							39 01 00 00 00 00 0F B3 03 8C 03 9B 03 AD 03 CA 03 CF 03 D0 00 00
							39 01 00 00 00 00 11 B4 00 73 00 82 00 9E 00 B4 00 C8 00 D9 00 EA 00 F9
							39 01 00 00 00 00 11 B5 01 05 01 35 01 5A 01 99 01 C8 02 13 02 50 02 51
							39 01 00 00 00 00 11 B6 02 89 02 C6 02 EC 03 1A 03 3E 03 63 03 70 03 7D
							39 01 00 00 00 00 0F B7 03 8C 03 9B 03 AD 03 CA 03 CF 03 D0 00 00
							39 01 00 00 00 00 11 B8 00 73 00 82 00 9E 00 B4 00 C8 00 D9 00 EA 00 F9
							39 01 00 00 00 00 11 B9 01 05 01 35 01 5A 01 99 01 C8 02 13 02 50 02 51
							39 01 00 00 00 00 11 BA 02 89 02 C6 02 EC 03 1A 03 3E 03 63 03 70 03 7D
							39 01 00 00 00 00 0F BB 03 8C 03 9B 03 AD 03 CA 03 CF 03 D0 00 00
							39 01 00 00 00 00 02 FF 21
							39 01 00 00 00 00 11 B0 00 BB 00 C7 00 DE 00 F1 01 01 01 10 01 1D 01 2A
							39 01 00 00 00 00 11 B1 01 34 01 5C 01 7A 01 AC 01 D1 02 13 02 50 02 51
							39 01 00 00 00 00 11 B2 02 89 02 CB 02 F5 03 27 03 42 03 5E 03 69 03 74
							39 01 00 00 00 00 0F B3 03 81 03 8E 03 9C 03 B7 03 BA 03 BB 00 00
							39 01 00 00 00 00 11 B4 00 BB 00 C7 00 DE 00 F1 01 01 01 10 01 1D 01 2A
							39 01 00 00 00 00 11 B5 01 34 01 5C 01 7A 01 AC 01 D1 02 13 02 50 02 51
							39 01 00 00 00 00 11 B6 02 89 02 CB 02 F5 03 27 03 42 03 5E 03 69 03 74
							39 01 00 00 00 00 0F B7 03 81 03 8E 03 9C 03 B7 03 BA 03 BB 00 00
							39 01 00 00 00 00 11 B8 00 BB 00 C7 00 DE 00 F1 01 01 01 10 01 1D 01 2A
							39 01 00 00 00 00 11 B9 01 34 01 5C 01 7A 01 AC 01 D1 02 13 02 50 02 51
							39 01 00 00 00 00 11 BA 02 89 02 CB 02 F5 03 27 03 42 03 5E 03 69 03 74
							39 01 00 00 00 00 0F BB 03 81 03 8E 03 9C 03 B7 03 BA 03 BB 00 00
							39 01 00 00 00 00 02 FF 10
						];

						qcom,mdss-dsi-pre-off-command = [
							39 01 00 00 00 00 02 FF 10
							05 01 00 00 0B 00 02 28 00
							05 01 00 00 33 00 02 10 00
						];

						qcom,mdss-dsi-on-command-state = "dsi_lp_mode";
						qcom,mdss-dsi-pre-off-command-state = "dsi_lp_mode";
						sharp,mdss-dsi-typ-volt-command-state = "dsi_lp_mode";
						sharp,mdss-dsi-typ-gmm-command-state = "dsi_lp_mode";

						qcom,mdss-dsi-h-sync-pulse = <0>;

						qcom,compression-mode = "dsc";

						qcom,mdss-dsc-slice-height = <8>;
						qcom,mdss-dsc-slice-width = <720>;
						qcom,mdss-dsc-slice-per-pkt = <1>;

						qcom,mdss-dsc-bit-per-component = <8>;
						qcom,mdss-dsc-bit-per-pixel = <8>;
						qcom,mdss-dsc-block-prediction-enable;
				};
		};
	};
};

## drivers/input/misc/fpsensor/Kconfig
```kconfig
#
# Sensor  drivers configuration
#

config SENSORS_FINGERPRINT
	bool "Finger Print Sensor devices"
	help
	  Say Y here, and a list of sensors drivers will be displayed.
	  Everything that didn't fit into the other categories is here. This option
	  doesn't affect the kernel.

	  If unsure, say Y.

if SENSORS_FINGERPRINT

source "drivers/input/misc/fpsensor/fpc1145/Kconfig"
source "drivers/input/misc/fpsensor/fpc1291/Kconfig"

endif # SENSORS_FINGERPRINT
```

## drivers/input/misc/fpsensor/fpc1145/Kconfig
```kconfig
#
# Sensor  drivers configuration
#

menu "SENSORS_FRPRINT_FPC"

config SENSORS_FPRINT_FPC_PLATFORM_1145
	tristate "FPC fingerprint sensor platform support"
	default n
	help
	  If you say yes here you get support for the platform of the fpc fingerprint sensor.

config SENSORS_FPRINT_SHARP_CUSTOMIZE
	bool "fingerprint sensor enable sharp customize"
	default n
	help
	  If you say yes here you can enable Sharp customize.

endmenu
```

## drivers/input/touchscreen/shtps/Kconfig
```kconfig
#
# Sharp Touchscreen configuration
#

menu "SHARP TPS driver"

comment "SHARP Touchscreen device drivers"

config TOUCHSCREEN_SHARP_TPS
	bool "SHARP Touchscreens"
	default n

if TOUCHSCREEN_SHARP_TPS
	source "drivers/input/touchscreen/shtps/sy3000/Kconfig"
endif # TOUCHSCREEN_SHARP_TPS

endmenu
```

## drivers/input/touchscreen/shtps/sy3000/Kconfig
```kconfig
#
# Sharp Touchscreen configuration
#

if TOUCHSCREEN_SHARP_TPS

	config SHARP_TPS_SY3X00_DEV
		tristate "SY3x00 Device"
		default n
		depends on TOUCHSCREEN_SHARP_TPS

	config SHARP_TPS_SY3000_PRJ_001860
		tristate "SY3000 PRJ-001860"
		default n
		depends on SHARP_TPS_SY3X00_DEV

	config SHARP_TPS_SY3700_CUSPRJ_1846
		tristate "SY3700 CUSPRJ-1846"
		default n
		depends on SHARP_TPS_SY3X00_DEV

	config SHARP_TPS_SY3700_CUSPRJ_2295
		tristate "SY3700 CUSPRJ-2295"
		default n
		depends on SHARP_TPS_SY3X00_DEV

endif # TOUCHSCREEN_SHARP_TPS
```

## drivers/media/shtunerdrv_fseg/Kconfig
```kconfig
# drivers/media/shtunerdrv_fseg/Kconfig

menu "SHARP DTV Tuner Configuration(Fseg)"

config SHARP_DTV_TUNERDEV_FSEG
	tristate "set SHARP DTV tuner dev.(Fseg)"
	default n

endmenu
```

## drivers/misc/shbatt/Kconfig
```kconfig
#
# Battery Control Configuration
#

menu "SHARP Battery Driver"

comment "Battery Control Configuration"

config SHARP_BATTERY_MODULE
	tristate "SHARP Battery Module Support"
	default n

config PM_SUPPORT_BATT_TRACEABILITY
	bool "SHARP Battery traceability"
	default n

endmenu
```

## drivers/misc/shflip/Kconfig
```kconfig
#
# Flip driver configuration
#

menu "SHARP Flip Driver"

config SHARP_FLIP
	tristate "SHARP external cover flip support"
	default n

endmenu
```

## drivers/misc/shhall/Kconfig
```kconfig
#
# Flip driver configuration
#

menu "SHARP Hall IC Driver"

config SHARP_HALL
	tristate "SHARP external cover detection by Hall sensor"
	default n

endmenu
```

## drivers/misc/shsensor_hub/ml630q790/Kconfig
```kconfig
#
# SensorHub drivers configuration
#

menu "SHARP ML630Q790 devices"

config SHUB_ML630Q790
	bool "LAPIS Semicomductor ML610Q793 SensorHub Micom"
	default y
	help
	 --- help ---
	 If you say yes here you get support for SHUB_ML630Q790.

endmenu
```

## drivers/misc/shterm/Kconfig
```kconfig
# drivers/misc/shterm/Kconfig

menu "SHTERM"

comment "SHTERM"

config SHARP_SHTERM
bool "SHARP SHTERM driver"
default y

endmenu
```

## drivers/mmc/Kconfig
```kconfig
#
# MMC subsystem configuration
#

menuconfig MMC
	tristate "MMC/SD/SDIO card support"
	depends on HAS_IOMEM
	help
	  This selects MultiMediaCard, Secure Digital and Secure
	  Digital I/O support.

	  If you want MMC/SD/SDIO support, you should say Y here and
	  also to your specific host controller driver.

config MMC_DEBUG
	bool "MMC debugging"
	depends on MMC != n
	help
	  This is an option for use by developers; most people should
	  say N here.  This enables MMC core and driver debugging.

config MMC_PERF_PROFILING
	bool "MMC performance profiling"
	depends on MMC != n
	default n
	help
	  If you say Y here, support will be added for collecting
	  performance numbers at the MMC Queue and Host layers.

config SHARP_MMC
	bool "SHARP MMC driver customized"
	depends on MMC
	default n

config SHARP_MMC_SD
	bool "SHARP SD driver customized"
	depends on SHARP_MMC
	default n

config SHARP_MMC_SD_ENABLE_ONLY_DDR50
	bool "SHARP SD driver customized for enable DDR50 mode"
	depends on SHARP_MMC_SD
	default n

config SHARP_MMC_SD_ECO_MODE
	bool "SHARP SD driver customized for Reduce the noise interference between SD access and DTV"
	depends on SHARP_MMC_SD
	default n

config SHARP_MMC_SD_BATTLOG
	bool "SHARP SD driver customized for logging"
	depends on SHARP_MMC_SD
	default n

config SHARP_MMC_SD_DISABLE_CLK_SCALE
	bool "SHARP SD driver customized for disable Clock Scaling"
	depends on SHARP_MMC_SD
	default n

if MMC

source "drivers/mmc/core/Kconfig"

source "drivers/mmc/card/Kconfig"

source "drivers/mmc/host/Kconfig"

endif # MMC
```

## drivers/net/wireless/sh_wlan_fac/Kconfig
```kconfig
menu "SHARP WLAN factory support"

config SHARP_WLAN_FACTORY
	tristate "Sharp WLAN factory support"
	default n

endmenu
```

## drivers/nfc/cxd224x/Kconfig
```kconfig
#
# Near Field Communication (NFC) devices
#

menu "CXD224X NFC Chip Driver Support"

config NFC_CXD224X
	tristate "CXD224X NFC driver"

	depends on I2C
	select CRC_CCITT
	default n
	---help---
	  Say yes if you want cxd224x Near Field Communication driver.
	  This is for i2c connected version. If unsure, say N here.

	  To compile this driver as a module, choose m here. The module will
	  be called cxd224x-i2c.

config NFC_CXD224X_PROBE_RST
	bool "CXD224X PROBE RST"
	default n

config NFC_CXD224X_RST_USE_PMIC
	bool "CXD224X RST USE PMIC"
	default n

endmenu
```

## drivers/sharp/Kconfig
```kconfig
#
# SHARP configuration
#

menu "SHARP Device Drivers"

#/* SH_AUDIO_DRIVER -> */ /* A-002 */
source "drivers/sharp/shaudio/Kconfig"
#/* SH_AUDIO_DRIVER <- */ /* A-002 */

source "drivers/sharp/proximity_light/Kconfig"

source "drivers/sharp/proximity/Kconfig"

endmenu
```

## drivers/sharp/proximity/Kconfig
```kconfig
#
# Proximity device configuration
#
# drivers/sharp/proximity/Kconfig

menu "Proximity Configuration"

config PROXIMITY_CHECKER
	tristate "Proximity checker driver"
	default n

endmenu
```

## drivers/sharp/proximity_light/Kconfig
```kconfig
#
# SHPsals device configuration
#
# drivers/sharp/proximity_light/Kconfig

menu "SHARP Psals Configuration"

config SHARP_PSALS_SMEM_READ
	tristate "SHARP Psals drivers (smem read)"
	default n

endmenu
```

## drivers/sharp/shaudio/Kconfig
```kconfig
#
# audio device configuration
#
# CONFIG_SH_AUDIO_DRIVER newly created

menu "SHARP audio driver"

comment "SHARP audio drivers"

config SH_AUDIO_DRIVER_MODEL_NUMBER
	int "SH_AUDIO_DRIVER_MODEL_NUMBER"
	range 0 999
	default "0"

config SH_AUDIO_DRIVER
	tristate "SHARP Audio Driver customized"
	default y

config SND_SOC_TREBLE_ENABLE
	tristate "SHARP Audio Driver Treble Enable"
	default y

endmenu
```

## drivers/soc/qcom/sharp/Kconfig
```kconfig
#
# SHARP configuration
#

menu "SHARP Device Drivers for Qualcomm SOC"

comment "SHARP Device Drivers for Qualcomm SOC"

config SHARP_SHLOG
	tristate "SHARP SHLOG driver base system."
	default n
	help
	  SHARP SHLOG driver base system.

config SHARP_SHLOG_RAMOOPS
	bool "Enable SHARP SHLOG for ramoops."
	depends on SHARP_SHLOG
	default n
	help
	  Enable SHARP SHLOG for ramoops.

config SHARP_SHLOG_TASKLIST
	bool "Enable SHARP SHLOG for tasks."
	depends on SHARP_SHLOG
	default n
	help
	  Enable SHARP SHLOG for tasks.

config SHARP_SHLOG_LATESTSTACK
	bool "Enable SHARP SHLOG for tasks of latest process."
	depends on SHARP_SHLOG
	default n
	help
	  Enable SHARP SHLOG for tasks of latest process.

config SHARP_HANDLE_PANIC
	bool "Enable SHARP handler for panic."
	depends on SHARP_SHLOG
	default n
	help
	  Enable SHARP handler for panic.

config SHARP_HANDLE_DLOAD
	bool "Enable SHARP handler for dload."
	depends on SHARP_SHLOG
	default n
	help
	  Enable SHARP handler for dload.

config SHARP_HANDLE_DLOAD_MINIDEFAULT
	bool "Set default of dload to mini."
	depends on SHARP_HANDLE_DLOAD
	default n
	help
	  Enable Set default of dload to mini.

config SHARP_HANDLE_SURFACE_FLINGER
	bool "Enable SHARP handler for reset of surfaceflinger."
	depends on SHARP_SHLOG
	default n
	help
	  Enable SHARP handler for reset of surfaceflinger.

config SHARP_PANIC_ON_PWRKEY
	bool "Enable SHARP handler to call panic when powerkey pressed."
	depends on SHARP_SHLOG
	default n
	help
	  Enable SHARP handler to call panic when powerkey pressed.

config SHARP_PANIC_ON_PWRKEY_TIMEOUT
	int "Timeout to call panic when power-key is pressed."
	depends on SHARP_SHLOG
	default 4
	help
	  Timeout to call panic when power-key is pressed.

config SHARP_SHLOG_SHOW_ABOOTLOG
	bool "Enable dumping aboot-log after boot."
	depends on SHARP_SHLOG
	default n
	help
	  Enable dumping aboot-log after boot.

config SHARP_SUPPORT_DLOAD_BOOTPARAM
	bool "Add parameter to set initial value for dload."
	default n
	help
	  Add parameter to set initial value for dload.

source "drivers/soc/qcom/sharp/shtimer/Kconfig"

source "drivers/soc/qcom/sharp/pnp/Kconfig"

source "drivers/soc/qcom/sharp/shboot/Kconfig"

endmenu

menu "SHARP SHDIAG SMEM driver"

comment "SHARP SHDIAG SMEM driver"

config SHARP_SHDIAG_SMD
	tristate "SHARP SHDIAG SMEM DRIVER"
	depends on SHARP_SMEM_CUST
	default n
endmenu
```

## drivers/soc/qcom/sharp/pnp/Kconfig
```kconfig
# drivers/soc/qcom/sharp/pnp/Kconfig

menu "SHARP Power and Performance(PnP)"

config SHARP_PNP
	bool "SHARP PnP customize"
	default n

config SHARP_PNP_CLOCK
	bool "Enable SHARP PnP customize clock"
	depends on SHARP_PNP
	default y

config SHARP_PNP_CLOCK_DEBUG
	bool "Enable SHARP PnP customize clock debug"
	depends on SHARP_PNP
	default y

config SHARP_PNP_THERMAL
	bool "Enable SHARP PnP customize thermal"
	depends on SHARP_PNP
	default y

config SHARP_PNP_SLEEP
	bool "Enable SHARP PnP customize sleep"
	depends on SHARP_PNP
	default y

config SHARP_PNP_SLEEP_DEBUG
	bool "Enable SHARP PnP customize sleep debug"
	depends on SHARP_PNP
	default y

config SHARP_PNP_SLEEP_SLEEPLOG
	bool "Enable SHARP PnP customize sleep sleeplog"
	depends on SHARP_PNP
	default y

endmenu
```

## drivers/soc/qcom/sharp/shboot/Kconfig
```kconfig
#
# Sharp Boot Driver
#

menu "Sharp Boot Driver"

config SHARP_BOOT
	bool "SHARP BOOT DRIVER"
	depends on SHARP_SMEM_CUST
	default n

endmenu
```

## drivers/soc/qcom/sharp/shtimer/Kconfig
```kconfig
# drivers/soc/qcom/sharp/shtimer/Kconfig

menu "SHTIMER"

comment "SHARP SHTIMER"

config SHARP_SHTIMER
bool "SHARP Timer"
default y

endmenu
```

## sound/soc/codecs/tfa/Kconfig
```kconfig
menu "NXP Audio Chip"

config SND_SOC_NXP_CHIP
	tristate "NXP Audio Chip"
	---help---
	  Enable support for NXP Audio Chip

config SND_SOC_NXP_TFA98XX
	depends on SND_SOC_NXP_CHIP
	tristate "NXP TFA98XX"
	---help---
	  Enable TFA98XX

endmenu
```

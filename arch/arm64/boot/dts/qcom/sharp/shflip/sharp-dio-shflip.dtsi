/* Copyright (c) 2017, The Linux Foundation. All rights reserved.
 *
 * This program is free software; you can redistribute it and/or modify
 * it under the terms of the GNU General Public License version 2 and
 * only version 2 as published by the Free Software Foundation.
 *
 * This program is distributed in the hope that it will be useful,
 * but WITHOUT ANY WARRANTY; without even the implied warranty of
 * MERCHANTABILITY or FITNESS FOR A PARTICULAR PURPOSE.  See the
 * GNU General Public License for more details.
 */

&soc {
	sharp,flip {
		status = "ok";
		compatible = "sharp,flip";
		qcom,shflip-det-gpio = <&tlmm 124 0>;
		interrupt-parent = <&tlmm>;
		interrupts = <124 0>;
		interrupt-names = "shflip_det";
		pinctrl-names = "shflip_det_active",
				"shflip_det_suspend";
		pinctrl-0 = <&shflip_det_active>;
		pinctrl-1 = <&shflip_det_suspend>;
	};
};


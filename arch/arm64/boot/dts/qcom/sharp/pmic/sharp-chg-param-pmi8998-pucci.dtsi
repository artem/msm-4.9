/* Copyright (c) 2017, The Linux Foundation. All rights reserved.
 *
 * This program is free software; you can redistribute it and/or modify
 * it under the terms of the GNU General Public License version 2 and
 * only version 2 as published by the Free Software Foundation.
 *
 * This program is distributed in the hope that it will be useful,
 * but WITHOUT ANY WARRANTY; without even the implied warranty of
 * MERCHANTABILITY or FITNESS FOR A PARTICULAR PURPOSE.  See the
 * GNU General Public License for more details.
 */


/****************************************/
/* pmi8998_charger		*/
/****************************************/
&pmi8998_charger {
	qcom,fcc-max-ua = <1750000>;
	/delete-property/ qcom,step-charging-enable;
	qcom,hvdcp-disable;
};

/****************************************/
/* pmi8998_fg		*/
/****************************************/

/****************************************/
/* thermal_zones		*/
/****************************************/


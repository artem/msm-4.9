/* Copyright (c) 2017, The Linux Foundation. All rights reserved.
 *
 * This program is free software; you can redistribute it and/or modify
 * it under the terms of the GNU General Public License version 2 and
 * only version 2 as published by the Free Software Foundation.
 *
 * This program is distributed in the hope that it will be useful,
 * but WITHOUT ANY WARRANTY; without even the implied warranty of
 * MERCHANTABILITY or FITNESS FOR A PARTICULAR PURPOSE.  See the
 * GNU General Public License for more details.
 */

&mdss_mdp {

	/*---------------------*/
	/* LCD Panel (MDP/DSI) */
	/*---------------------*/
	dsi_shdisp_rm69350_qe_cmd: sharp,shdisp_rm69350_qe_cmd {
		qcom,mdss-dsi-panel-name = "sharp 1440p cmd mode dsi panel";
		qcom,mdss-dsi-panel-type = "dsi_cmd_mode";
		qcom,mdss-dsi-virtual-channel-id = <0>;
		qcom,mdss-dsi-stream = <0>;
		qcom,mdss-dsi-bpp = <24>;
		qcom,mdss-dsi-underflow-color = <0xff>;
		qcom,mdss-dsi-border-color = <0>;
		qcom,mdss-dsi-color-order = "rgb_swap_rgb";
		qcom,mdss-dsi-traffic-mode = "non_burst_sync_event";
		qcom,mdss-dsi-bllp-eof-power-mode;
		qcom,mdss-dsi-bllp-power-mode;
		qcom,mdss-dsi-lane-0-state;
		qcom,mdss-dsi-lane-1-state;
		qcom,mdss-dsi-lane-2-state;
		qcom,mdss-dsi-lane-3-state;
		qcom,mdss-pan-physical-width-dimension = <68>;
		qcom,mdss-pan-physical-height-dimension = <141>;
		qcom,mdss-dsi-reset-sequence = <1 8>, <0 1>, <1 8>;
		qcom,mdss-dsi-dma-trigger = "trigger_sw";
		qcom,mdss-dsi-mdp-trigger = "none";
		qcom,mdss-dsi-t-clk-post = <0x0C>;
		qcom,mdss-dsi-t-clk-pre = <0x29>;
		qcom,esd-check-enabled;
		qcom,mdss-dsi-panel-status-check-mode = "reg_read";
		qcom,mdss-dsi-panel-status-command = [
			06 01 00 01 00 00 01 6B
		];
		qcom,mdss-dsi-panel-status-command-state = "dsi_lp_mode";
		qcom,mdss-dsi-panel-status-value = <0x18>;
		qcom,mdss-dsi-panel-status-read-length = <1>;
		qcom,mdss-dsi-wr-mem-start = <0x2c>;
		qcom,mdss-dsi-wr-mem-continue = <0x3c>;
		qcom,mdss-dsi-te-pin-select = <1>;
		qcom,mdss-dsi-te-dcs-command = <1>;
		qcom,mdss-dsi-te-check-enable;
		qcom,mdss-dsi-te-using-te-pin;
		qcom,mdss-dsi-lp11-init;
		qcom,mdss-dsi-bl-pmic-control-type = "bl_ctrl_dcs";
		qcom,panel-supply-entries = <&dsi_panel_pwr_supply_no_labibb>;
		qcom,mdss-dsi-bl-min-level = <1>;
		qcom,mdss-dsi-bl-max-level = <4095>;
		qcom,platform-reset-gpio = <&tlmm 6 0>;
		sharp,panel-vcc-supply-gpio = <&tlmm 9 0>;
		qcom,mdss-dsi-tx-eot-append;

		qcom,mdss-dsi-panel-hdr-enabled;
		qcom,mdss-dsi-panel-hdr-color-primaries = <15635 16450 34000
							   16000 13250 34500 7500 3000>;
		qcom,mdss-dsi-panel-peak-brightness = <4000000>;
		qcom,mdss-dsi-panel-blackness-level = <0>;
		qcom,mdss-dsi-panel-average-brightness = <4000000>;

		sharp,dsi-linear-params = <
		//	x	y
			32	150
			48	170
			80	200
			144	237
			224	398
			369	653
			513	902
			802	1216
			1059	1447
			1429	1683
			1750	1846
			2151	2007
			2633	2175
			3083	2317
			3613	2462
			4095	2575
		>;

		qcom,mdss-dsi-display-timings {
			timing@0{
				qcom,mdss-dsi-panel-clockrate = <0 725200000>;

				qcom,mdss-dsi-panel-width = <1440>;
				qcom,mdss-dsi-panel-height = <2992>;
				qcom,mdss-dsi-h-front-porch = <144>;
				qcom,mdss-dsi-h-back-porch = <32>;
				qcom,mdss-dsi-h-pulse-width = <4>;
				qcom,mdss-dsi-h-sync-skew = <0>;
				qcom,mdss-dsi-v-back-porch = <8>;
				qcom,mdss-dsi-v-front-porch = <32>;
				qcom,mdss-dsi-v-pulse-width = <8>;

				qcom,mdss-dsi-h-left-border = <0>;
				qcom,mdss-dsi-h-right-border = <0>;
				qcom,mdss-dsi-v-top-border = <0>;
				qcom,mdss-dsi-v-bottom-border = <0>;

				qcom,mdss-dsi-panel-framerate = <60>;

				qcom,mdss-dsi-panel-phy-timings = [00 1A 06 06 22 20
					07 06 04 03 04 00];

				qcom,display-topology = <1 1 1>;
				qcom,default-topology-index = <0>;

				qcom,mdss-dsi-panel-jitter = <0x20 0xa>;

				qcom,mdss-dsi-on-command = [
					15 01 00 00 00 00 02 FE 40
					15 01 00 00 00 00 02 05 20
					15 01 00 00 00 00 02 06 10
					15 01 00 00 00 00 02 08 20
					15 01 00 00 00 00 02 09 10
					15 01 00 00 00 00 02 0A F6
					15 01 00 00 00 00 02 0B 11
					15 01 00 00 00 00 02 0C F6
					15 01 00 00 00 00 02 0E 60
					15 01 00 00 00 00 02 0F B0
					15 01 00 00 00 00 02 10 8B
					15 01 00 00 00 00 02 11 01
					15 01 00 00 00 00 02 21 00
					15 01 00 00 00 00 02 22 00
					15 01 00 00 00 00 02 24 3F
					15 01 00 00 00 00 02 28 13
					15 01 00 00 00 00 02 29 40
					15 01 00 00 00 00 02 2A 40
					15 01 00 00 00 00 02 2B 02
					15 01 00 00 00 00 02 2D 02
					15 01 00 00 00 00 02 40 08
					15 01 00 00 00 00 02 41 0C
					15 01 00 00 00 00 02 47 11
					15 01 00 00 00 00 02 48 11
					15 01 00 00 00 00 02 49 00
					15 01 00 00 00 00 02 4A 00
					15 01 00 00 00 00 02 51 80
					15 01 00 00 00 00 02 6B 04
					15 01 00 00 00 00 02 6C 01
					15 01 00 00 00 00 02 78 41
					15 01 00 00 00 00 02 83 86
					15 01 00 00 00 00 02 84 33
					15 01 00 00 00 00 02 A6 02
					15 01 00 00 00 00 02 AC 84
					15 01 00 00 00 00 02 AE 21
					15 01 00 00 00 00 02 B3 32
					15 01 00 00 00 00 02 FE 60
					15 01 00 00 00 00 02 C1 03
					15 01 00 00 00 00 02 CA D5
					15 01 00 00 00 00 02 CB 83
					15 01 00 00 00 00 02 CC 84
					15 01 00 00 00 00 02 CD D0
					15 01 00 00 00 00 02 CE 81
					15 01 00 00 00 00 02 CF 82
					15 01 00 00 00 00 02 D0 C0
					15 01 00 00 00 00 02 D1 14
					15 01 00 00 00 00 02 D2 14
					15 01 00 00 00 00 02 D3 14
					15 01 00 00 00 00 02 D4 14
					15 01 00 00 00 00 02 D5 14
					15 01 00 00 00 00 02 D6 14
					15 01 00 00 00 00 02 D7 14
					15 01 00 00 00 00 02 D8 14
					15 01 00 00 00 00 02 D9 14
					15 01 00 00 00 00 02 DA 14
					15 01 00 00 00 00 02 DB 14
					15 01 00 00 00 00 02 DC D5
					15 01 00 00 00 00 02 DD 83
					15 01 00 00 00 00 02 DE 84
					15 01 00 00 00 00 02 DF D0
					15 01 00 00 00 00 02 E0 81
					15 01 00 00 00 00 02 E1 82
					15 01 00 00 00 00 02 E2 C0
					15 01 00 00 00 00 02 E3 14
					15 01 00 00 00 00 02 E4 14
					15 01 00 00 00 00 02 E5 14
					15 01 00 00 00 00 02 E6 14
					15 01 00 00 00 00 02 E7 14
					15 01 00 00 00 00 02 E8 14
					15 01 00 00 00 00 02 E9 14
					15 01 00 00 00 00 02 EA 14
					15 01 00 00 00 00 02 EB 14
					15 01 00 00 00 00 02 EC 14
					15 01 00 00 00 00 02 ED 14
					15 01 00 00 00 00 02 F3 40
					15 01 00 00 00 00 02 FE 70
					15 01 00 00 00 00 02 6F 01
					15 01 00 00 00 00 02 BA 84
					15 01 00 00 00 00 02 BB 00
					15 01 00 00 00 00 02 BC 0A
					15 01 00 00 00 00 02 BD 00
					15 01 00 00 00 00 02 BE 30
					15 01 00 00 00 00 02 BF 70
					15 01 00 00 00 00 02 C0 EB
					15 01 00 00 00 00 02 C1 96
					15 01 00 00 00 00 02 C2 E8
					15 01 00 00 00 00 02 C3 CC
					15 01 00 00 00 00 02 C4 90
					15 01 00 00 00 00 02 C6 00
					15 01 00 00 00 00 02 C7 84
					15 01 00 00 00 00 02 C8 84
					15 01 00 00 00 00 02 C9 00
					15 01 00 00 00 00 02 CA 0A
					15 01 00 00 00 00 02 CB 0A
					15 01 00 00 00 00 02 CC 00
					15 01 00 00 00 00 02 CD 0F
					15 01 00 00 00 00 02 D9 00
					15 01 00 00 00 00 02 DA EB
					15 01 00 00 00 00 02 DB 04
					15 01 00 00 00 00 02 DC EA
					15 01 00 00 00 00 02 DD 67
					15 01 00 00 00 00 02 DE F4
					15 01 00 00 00 00 02 DF 00
					15 01 00 00 00 00 02 E0 11
					15 01 00 00 00 00 02 E1 00
					15 01 00 00 00 00 02 E2 11
					15 01 00 00 00 00 02 E3 10
					15 01 00 00 00 00 02 E4 64
					15 01 00 00 00 00 02 E5 00
					15 01 00 00 00 00 02 E6 00
					15 01 00 00 00 00 02 E7 00
					15 01 00 00 00 00 02 E8 00
					15 01 00 00 00 00 02 E9 00
					15 01 00 00 00 00 02 EA 00
					15 01 00 00 00 00 02 FE 90
					15 01 00 00 00 00 02 12 64
					15 01 00 00 00 00 02 13 64
					15 01 00 00 00 00 02 14 64
					15 01 00 00 00 00 02 15 46
					15 01 00 00 00 00 02 16 46
					15 01 00 00 00 00 02 17 46
					15 01 00 00 00 00 02 18 64
					15 01 00 00 00 00 02 19 64
					15 01 00 00 00 00 02 1A 64
					15 01 00 00 00 00 02 1B 46
					15 01 00 00 00 00 02 1C 46
					15 01 00 00 00 00 02 1D 46
					15 01 00 00 00 00 02 1E 64
					15 01 00 00 00 00 02 1F 64
					15 01 00 00 00 00 02 20 64
					15 01 00 00 00 00 02 21 46
					15 01 00 00 00 00 02 22 46
					15 01 00 00 00 00 02 23 46
					15 01 00 00 00 00 02 98 E7
					15 01 00 00 00 00 02 99 27
					15 01 00 00 00 00 02 9A 18
					15 01 00 00 00 00 02 FE D0
					15 01 00 00 00 00 02 03 09
					15 01 00 00 00 00 02 0A 40
					15 01 00 00 00 00 02 15 29
					15 01 00 00 00 00 02 16 28
					15 01 00 00 00 00 02 2A 15
					15 01 00 00 00 00 02 2B 15
					15 01 00 00 00 00 02 2D 15
					15 01 00 00 00 00 02 2F 15
					15 01 00 00 00 00 02 30 15
					15 01 00 00 00 00 02 31 15
					15 01 00 00 00 00 02 48 00
					15 01 00 00 00 00 02 4E 01
					15 01 00 00 00 00 02 4F FF
					15 01 00 00 00 00 02 50 10
					15 01 00 00 00 00 02 51 30
					15 01 00 00 00 00 02 52 0E
					15 01 00 00 00 00 02 5C 03
					15 01 00 00 00 00 02 89 00
					15 01 00 00 00 00 02 8A 00
					15 01 00 00 00 00 02 FE A0
					15 01 00 00 00 00 02 04 86
					15 01 00 00 00 00 02 05 21
					15 01 00 00 00 00 02 1B 00
					15 01 00 00 00 00 02 23 10
					15 01 00 00 00 00 02 24 E6
					15 01 00 00 00 00 02 27 80
					15 01 00 00 00 00 02 32 B3
					15 01 00 00 00 00 02 35 B3
					15 01 00 00 00 00 02 3A 03
					15 01 00 00 00 00 02 EE C0
					15 01 00 00 00 00 02 FE D2
					15 01 00 00 00 00 02 36 00
					15 01 00 00 00 00 02 37 40
					15 01 00 00 00 00 02 FE 00
					15 01 00 00 00 00 02 FA 01
					15 01 00 00 00 00 02 FE D2
					15 01 00 00 00 00 02 4F 08
					15 01 00 00 00 00 02 50 11
					15 01 00 00 00 00 02 51 89
					15 01 00 00 00 00 02 52 30
					15 01 00 00 00 00 02 53 0B
					15 01 00 00 00 00 02 54 B0
					15 01 00 00 00 00 02 55 05
					15 01 00 00 00 00 02 56 A0
					15 01 00 00 00 00 02 58 00
					15 01 00 00 00 00 02 59 10
					15 01 00 00 00 00 02 5A 02
					15 01 00 00 00 00 02 5B D0
					15 01 00 00 00 00 02 5C 02
					15 01 00 00 00 00 02 5D 00
					15 01 00 00 00 00 02 5E 20
					15 01 00 00 00 00 02 5F 01
					15 01 00 00 00 00 02 60 BB
					15 01 00 00 00 00 02 61 00
					15 01 00 00 00 00 02 62 0A
					15 01 00 00 00 00 02 63 0C
					15 01 00 00 00 00 02 64 06
					15 01 00 00 00 00 02 65 67
					15 01 00 00 00 00 02 66 04
					15 01 00 00 00 00 02 67 C5
					15 01 00 00 00 00 02 68 18
					15 01 00 00 00 00 02 69 00
					15 01 00 00 00 00 02 6A 10
					15 01 00 00 00 00 02 6B F0
					15 01 00 00 00 00 02 6C 03
					15 01 00 00 00 00 02 6D 0C
					15 01 00 00 00 00 02 6E 20
					15 01 00 00 00 00 02 6F 00
					15 01 00 00 00 00 02 70 06
					15 01 00 00 00 00 02 71 0B
					15 01 00 00 00 00 02 72 0B
					15 01 00 00 00 00 02 73 33
					15 01 00 00 00 00 02 74 0E
					15 01 00 00 00 00 02 75 1C
					15 01 00 00 00 00 02 76 2A
					15 01 00 00 00 00 02 77 38
					15 01 00 00 00 00 02 78 46
					15 01 00 00 00 00 02 79 54
					15 01 00 00 00 00 02 7A 62
					15 01 00 00 00 00 02 7B 69
					15 01 00 00 00 00 02 7C 70
					15 01 00 00 00 00 02 7D 77
					15 01 00 00 00 00 02 7E 79
					15 01 00 00 00 00 02 7F 7B
					15 01 00 00 00 00 02 80 7D
					15 01 00 00 00 00 02 81 7E
					15 01 00 00 00 00 02 82 01
					15 01 00 00 00 00 02 83 02
					15 01 00 00 00 00 02 84 01
					15 01 00 00 00 00 02 85 00
					15 01 00 00 00 00 02 86 09
					15 01 00 00 00 00 02 87 40
					15 01 00 00 00 00 02 88 09
					15 01 00 00 00 00 02 89 BE
					15 01 00 00 00 00 02 8A 19
					15 01 00 00 00 00 02 8B FC
					15 01 00 00 00 00 02 8C 19
					15 01 00 00 00 00 02 8D FA
					15 01 00 00 00 00 02 8E 19
					15 01 00 00 00 00 02 8F F8
					15 01 00 00 00 00 02 90 1A
					15 01 00 00 00 00 02 91 38
					15 01 00 00 00 00 02 92 1A
					15 01 00 00 00 00 02 93 78
					15 01 00 00 00 00 02 94 1A
					15 01 00 00 00 00 02 95 B6
					15 01 00 00 00 00 02 96 2A
					15 01 00 00 00 00 02 97 F6
					15 01 00 00 00 00 02 98 2B
					15 01 00 00 00 00 02 99 34
					15 01 00 00 00 00 02 9A 2B
					15 01 00 00 00 00 02 9B 74
					15 01 00 00 00 00 02 9C 3B
					15 01 00 00 00 00 02 9D 74
					15 01 00 00 00 00 02 9E 6B
					15 01 00 00 00 00 02 9F F4
					15 01 00 00 00 00 02 FE D0
					15 01 00 00 00 00 02 03 08
					15 01 00 00 00 00 02 FE 72
					15 01 00 00 00 00 02 10 05
					15 01 00 00 00 00 02 11 00
					15 01 00 00 00 00 02 12 00
					15 01 00 00 00 00 02 13 00
					15 01 00 00 00 00 02 14 15
					15 01 00 00 00 00 02 15 00
					15 01 00 00 00 00 02 16 20
					15 01 00 00 00 00 02 17 00
					15 01 00 00 00 00 02 18 31
					15 01 00 00 00 00 02 19 00
					15 01 00 00 00 00 02 1A 4C
					15 01 00 00 00 00 02 1B 00
					15 01 00 00 00 00 02 1C 76
					15 01 00 00 00 00 02 1D 01
					15 01 00 00 00 00 02 1E 24
					15 01 00 00 00 00 02 1F 01
					15 01 00 00 00 00 02 20 96
					15 01 00 00 00 00 02 21 02
					15 01 00 00 00 00 02 22 30
					15 01 00 00 00 00 02 23 02
					15 01 00 00 00 00 02 24 F5
					15 01 00 00 00 00 02 25 03
					15 01 00 00 00 00 02 26 88
					15 01 00 00 00 00 02 27 00
					15 01 00 00 00 00 02 28 00
					15 01 00 00 00 00 02 29 00
					15 01 00 00 00 00 02 2A 00
					15 01 00 00 00 00 02 2B 00
					15 01 00 00 00 00 02 2D 01
					15 01 00 00 00 00 02 2F 00
					15 01 00 00 00 00 02 30 02
					15 01 00 00 00 00 02 31 00
					15 01 00 00 00 00 02 32 05
					15 01 00 00 00 00 02 33 00
					15 01 00 00 00 00 02 34 0D
					15 01 00 00 00 00 02 35 00
					15 01 00 00 00 00 02 36 25
					15 01 00 00 00 00 02 37 00
					15 01 00 00 00 00 02 38 4E
					15 01 00 00 00 00 02 39 00
					15 01 00 00 00 00 02 3A B0
					15 01 00 00 00 00 02 3B 01
					15 01 00 00 00 00 02 3D 92
					15 01 00 00 00 00 02 3F 02
					15 01 00 00 00 00 02 40 94
					15 01 00 00 00 00 02 42 30
					15 01 00 00 00 00 02 43 10
					15 01 00 00 00 00 02 4A BE
					15 01 00 00 00 00 02 4B BE
					15 01 00 00 00 00 02 4C 00
					15 01 00 00 00 00 02 4D 0C
					15 01 00 00 00 00 02 A7 08
					15 01 00 00 00 00 02 BB 0D
					15 01 00 00 00 00 02 BC B6
					15 01 00 00 00 00 02 BD 00
					15 01 00 00 00 00 02 BE 02
					15 01 00 00 00 00 02 BF 49
					15 01 00 00 00 00 02 C0 BD
					15 01 00 00 00 00 02 C1 B6
					15 01 00 00 00 00 02 C2 6D
					15 01 00 00 00 00 02 C3 09
					15 01 00 00 00 00 02 C4 24
					15 01 00 00 00 00 02 C5 4D
					15 01 00 00 00 00 02 C6 B6
					15 01 00 00 00 00 02 C7 92
					15 01 00 00 00 00 02 C8 02
					15 01 00 00 00 00 02 C9 49
					15 01 00 00 00 00 02 CA 6D
					15 01 00 00 00 00 02 CB B6
					15 01 00 00 00 00 02 CC DB
					15 01 00 00 00 00 02 CD 09
					15 01 00 00 00 00 02 CE 24
					15 01 00 00 00 00 02 FE 00
					15 01 00 00 00 00 02 35 00
					39 01 00 00 00 00 03 51 00 00
					15 01 00 00 00 00 02 C2 08
					05 01 00 00 BE 00 02 11 00
				];

				sharp,mdss-dsi-typ-volt-command = [
					15 01 00 00 00 00 02 FE 40
					15 01 00 00 00 00 02 38 32
					15 01 00 00 00 00 02 3A 28
					15 01 00 00 00 00 02 FE D0
					15 01 00 00 00 00 02 93 06
					15 01 00 00 00 00 02 FE 50
					15 01 00 00 00 00 02 BD 41
					15 01 00 00 00 00 02 BE 30
				];

				sharp,mdss-dsi-typ-gmm-command = [
					15 01 00 00 00 00 02 00 00
					15 01 00 00 00 00 02 01 00
					15 01 00 00 00 00 02 02 02
					15 01 00 00 00 00 02 03 12
					15 01 00 00 00 00 02 04 02
					15 01 00 00 00 00 02 05 1D
					15 01 00 00 00 00 02 06 02
					15 01 00 00 00 00 02 07 29
					15 01 00 00 00 00 02 08 02
					15 01 00 00 00 00 02 09 64
					15 01 00 00 00 00 02 0A 02
					15 01 00 00 00 00 02 0B 9F
					15 01 00 00 00 00 02 0C 02
					15 01 00 00 00 00 02 0D CB
					15 01 00 00 00 00 02 0E 02
					15 01 00 00 00 00 02 0F EC
					15 01 00 00 00 00 02 10 03
					15 01 00 00 00 00 02 11 06
					15 01 00 00 00 00 02 12 03
					15 01 00 00 00 00 02 13 19
					15 01 00 00 00 00 02 14 03
					15 01 00 00 00 00 02 15 29
					15 01 00 00 00 00 02 16 03
					15 01 00 00 00 00 02 17 3B
					15 01 00 00 00 00 02 18 03
					15 01 00 00 00 00 02 19 4E
					15 01 00 00 00 00 02 1A 03
					15 01 00 00 00 00 02 1B 73
					15 01 00 00 00 00 02 1C 03
					15 01 00 00 00 00 02 1D 94
					15 01 00 00 00 00 02 1E 03
					15 01 00 00 00 00 02 1F B2
					15 01 00 00 00 00 02 20 03
					15 01 00 00 00 00 02 21 EF
					15 01 00 00 00 00 02 22 04
					15 01 00 00 00 00 02 23 2B
					15 01 00 00 00 00 02 24 04
					15 01 00 00 00 00 02 25 67
					15 01 00 00 00 00 02 26 04
					15 01 00 00 00 00 02 27 A3
					15 01 00 00 00 00 02 28 04
					15 01 00 00 00 00 02 29 E2
					15 01 00 00 00 00 02 2A 05
					15 01 00 00 00 00 02 2B 20
					15 01 00 00 00 00 02 30 05
					15 01 00 00 00 00 02 31 60
					15 01 00 00 00 00 02 32 05
					15 01 00 00 00 00 02 33 A5
					15 01 00 00 00 00 02 34 05
					15 01 00 00 00 00 02 35 F1
					15 01 00 00 00 00 02 36 06
					15 01 00 00 00 00 02 37 44
					15 01 00 00 00 00 02 38 06
					15 01 00 00 00 00 02 39 98
					15 01 00 00 00 00 02 3A 06
					15 01 00 00 00 00 02 3B F4
					15 01 00 00 00 00 02 40 00
					15 01 00 00 00 00 02 41 00
					15 01 00 00 00 00 02 42 02
					15 01 00 00 00 00 02 43 6B
					15 01 00 00 00 00 02 44 02
					15 01 00 00 00 00 02 45 72
					15 01 00 00 00 00 02 46 02
					15 01 00 00 00 00 02 47 7A
					15 01 00 00 00 00 02 48 02
					15 01 00 00 00 00 02 49 9C
					15 01 00 00 00 00 02 4A 02
					15 01 00 00 00 00 02 4B BE
					15 01 00 00 00 00 02 4C 02
					15 01 00 00 00 00 02 4D DB
					15 01 00 00 00 00 02 4E 02
					15 01 00 00 00 00 02 4F F4
					15 01 00 00 00 00 02 50 03
					15 01 00 00 00 00 02 51 08
					15 01 00 00 00 00 02 52 03
					15 01 00 00 00 00 02 53 17
					15 01 00 00 00 00 02 58 03
					15 01 00 00 00 00 02 59 23
					15 01 00 00 00 00 02 5A 03
					15 01 00 00 00 00 02 5B 31
					15 01 00 00 00 00 02 5C 03
					15 01 00 00 00 00 02 5D 42
					15 01 00 00 00 00 02 5E 03
					15 01 00 00 00 00 02 5F 62
					15 01 00 00 00 00 02 60 03
					15 01 00 00 00 00 02 61 7E
					15 01 00 00 00 00 02 62 03
					15 01 00 00 00 00 02 63 98
					15 01 00 00 00 00 02 64 03
					15 01 00 00 00 00 02 65 CE
					15 01 00 00 00 00 02 66 04
					15 01 00 00 00 00 02 67 02
					15 01 00 00 00 00 02 68 04
					15 01 00 00 00 00 02 69 3A
					15 01 00 00 00 00 02 6A 04
					15 01 00 00 00 00 02 6B 70
					15 01 00 00 00 00 02 6C 04
					15 01 00 00 00 00 02 6D AA
					15 01 00 00 00 00 02 6E 04
					15 01 00 00 00 00 02 6F E3
					15 01 00 00 00 00 02 70 05
					15 01 00 00 00 00 02 71 20
					15 01 00 00 00 00 02 72 05
					15 01 00 00 00 00 02 73 5F
					15 01 00 00 00 00 02 74 05
					15 01 00 00 00 00 02 75 A4
					15 01 00 00 00 00 02 76 05
					15 01 00 00 00 00 02 77 F1
					15 01 00 00 00 00 02 78 06
					15 01 00 00 00 00 02 79 41
					15 01 00 00 00 00 02 7A 06
					15 01 00 00 00 00 02 7B 99
					15 01 00 00 00 00 02 7C 00
					15 01 00 00 00 00 02 7D 00
					15 01 00 00 00 00 02 7E 02
					15 01 00 00 00 00 02 7F 8C
					15 01 00 00 00 00 02 80 02
					15 01 00 00 00 00 02 81 94
					15 01 00 00 00 00 02 82 02
					15 01 00 00 00 00 02 83 9C
					15 01 00 00 00 00 02 84 02
					15 01 00 00 00 00 02 85 C6
					15 01 00 00 00 00 02 86 02
					15 01 00 00 00 00 02 87 EF
					15 01 00 00 00 00 02 88 03
					15 01 00 00 00 00 02 89 0F
					15 01 00 00 00 00 02 8A 03
					15 01 00 00 00 00 02 8B 2D
					15 01 00 00 00 00 02 8C 03
					15 01 00 00 00 00 02 8D 48
					15 01 00 00 00 00 02 8E 03
					15 01 00 00 00 00 02 8F 5B
					15 01 00 00 00 00 02 90 03
					15 01 00 00 00 00 02 91 6C
					15 01 00 00 00 00 02 92 03
					15 01 00 00 00 00 02 93 7F
					15 01 00 00 00 00 02 94 03
					15 01 00 00 00 00 02 95 93
					15 01 00 00 00 00 02 96 03
					15 01 00 00 00 00 02 97 BD
					15 01 00 00 00 00 02 98 03
					15 01 00 00 00 00 02 99 E0
					15 01 00 00 00 00 02 9A 04
					15 01 00 00 00 00 02 9B 00
					15 01 00 00 00 00 02 9C 04
					15 01 00 00 00 00 02 9D 43
					15 01 00 00 00 00 02 9E 04
					15 01 00 00 00 00 02 9F 82
					15 01 00 00 00 00 02 A4 04
					15 01 00 00 00 00 02 A5 C2
					15 01 00 00 00 00 02 A6 05
					15 01 00 00 00 00 02 A7 02
					15 01 00 00 00 00 02 AC 05
					15 01 00 00 00 00 02 AD 44
					15 01 00 00 00 00 02 AE 05
					15 01 00 00 00 00 02 AF 86
					15 01 00 00 00 00 02 B0 05
					15 01 00 00 00 00 02 B1 CF
					15 01 00 00 00 00 02 B2 06
					15 01 00 00 00 00 02 B3 1A
					15 01 00 00 00 00 02 B4 06
					15 01 00 00 00 00 02 B5 6D
					15 01 00 00 00 00 02 B6 06
					15 01 00 00 00 00 02 B7 C4
					15 01 00 00 00 00 02 B8 07
					15 01 00 00 00 00 02 B9 1D
					15 01 00 00 00 00 02 BA 07
					15 01 00 00 00 00 02 BB 84
					15 01 00 00 00 00 02 FE 00
				];

				qcom,mdss-dsi-post-panel-on-command = [
					15 01 00 00 00 00 02 FE 00
					05 01 00 00 00 00 02 29 00
				];

				qcom,mdss-dsi-off-command = [
					15 01 00 00 00 00 02 FE 00
					05 01 00 00 64 00 02 28 00
					05 01 00 00 32 00 02 10 00
				];
				qcom,mdss-dsi-on-command-state = "dsi_lp_mode";
				qcom,mdss-dsi-post-panel-on-command-state = "dsi_lp_mode";
				qcom,mdss-dsi-off-command-state = "dsi_lp_mode";
				sharp,mdss-dsi-typ-volt-command-state = "dsi_lp_mode";
				sharp,mdss-dsi-typ-gmm-command-state = "dsi_lp_mode";
				qcom,mdss-dsi-h-sync-pulse = <0>;

				qcom,compression-mode = "dsc";

				qcom,mdss-dsc-slice-height = <16>;
				qcom,mdss-dsc-slice-width = <720>;
				qcom,mdss-dsc-slice-per-pkt = <2>;

				qcom,mdss-dsc-bit-per-component = <8>;
				qcom,mdss-dsc-bit-per-pixel = <8>;
				qcom,mdss-dsc-block-prediction-enable;
			};
		};

	};
};

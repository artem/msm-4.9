/* Copyright (c) 2016-2017, The Linux Foundation. All rights reserved.
 *
 * This program is free software; you can redistribute it and/or modify
 * it under the terms of the GNU General Public License version 2 and
 * only version 2 as published by the Free Software Foundation.
 *
 * This program is distributed in the hope that it will be useful,
 * but WITHOUT ANY WARRANTY; without even the implied warranty of
 * MERCHANTABILITY or FITNESS FOR A PARTICULAR PURPOSE.  See the
 * GNU General Public License for more details.
 */

&soc {

	fpc1020 {
		status = "ok";
		compatible = "fpc,fpc1020";
		input-device-name = "fpc1020";
		interrupt-parent = <&tlmm>;
		interrupts = <60 0x0>;
		fpc,gpio_rst    = <&tlmm 58 0>;
		fpc,gpio_irq    = <&tlmm 60 0>;
		/* vcc_spi-supply  = <none>; */
		vdd_io-supply   = <&pm8998_l22>;
		/* vdd_ana-supply  = <none>; */
		fpc,enable-on-boot;
		/* fpc,enable-wakeup; */

		pinctrl-names = "fpc1020_reset_reset",
				"fpc1020_reset_active",
				"fpc1020_irq_active";

		pinctrl-0 = <&fpc_reset_reset>;
		pinctrl-1 = <&fpc_reset_active>;
		pinctrl-2 = <&fpc_irq_active>;
	};

};

